## dts/bindings/input_processors/zmk,input-processor-drop-zero.yaml
```yaml
description: Drop zero-value input events

compatible: "zmk,input-processor-drop-zero"

properties:
  "#input-processor-cells":
    type: int
    required: true
    const: 0
```
